/* Part of LED Matrix Arduino library
 * Copyright (C) 2017 Kane Wallmann
 * See LICENCE.txt for license (MIT)*/

#include <limits.h>
#include "LedMatrix.h"

LedMatrix::LedMatrix(int *apin, int apin_count, int *cpin, int cpin_count, LedMatrixMode mode)
{
	this->mode = mode;

	this->apin = apin;
	this->cpin = cpin;

	this->apin_count = apin_count;
	this->cpin_count = cpin_count;

	this->timer = micros();
	this->current_col = 0;
	this->delay = LED_MATRIX_DEFAULT_DELAY;

	for( int a = 0; a < apin_count; a++ )
	{
		pinMode(apin[a], OUTPUT);
		digitalWrite(apin[a], LOW);
	}

	for( int a = 0; a < cpin_count; a++ )
	{
		pinMode(cpin[a], OUTPUT);
		digitalWrite(cpin[a], HIGH);
	}

	for( int x = 0; x < cpin_count; x++ )
	{
		for( int y = 0; y < apin_count; y++ )
		{
			this->state[x][y] = false;
		}
	}
}

void LedMatrix::ledTask()
{
	unsigned long time_passed;
	unsigned long us = micros();

	// Check for overflow on micros(), this works fine as long as AsyncTask was called less than ~70 minutes ago
	// Otherwise the next call will sort things out, no big deal.
	if( us < this->timer )
	{
		time_passed = ULONG_MAX - this->timer + us;
	}
	else
	{
		time_passed = us - this->timer;
	}

	// If it is time to move to next column
	if( time_passed > this->delay )
	{
		// Set the previous cathode pin high (OFF)
		digitalWrite(this->cpin[this->current_col], HIGH);

		// Increment column counter
		this->current_col++;

		// Wrap column counter
		if( this->current_col >= this->cpin_count )
		{
			this->current_col = 0;
		}

		// Store pointer to current column for convenience
		bool *row = this->state[this->current_col];

		// Cycle through rows and set them to desired state (HIGH for true or LOW for false)
		for( int a = 0; a < this->apin_count; a++ )
		{
			digitalWrite(this->apin[a], row[a]);
		}

		// Light up the row by changing the cathode to LOW (ON)
		digitalWrite(this->cpin[this->current_col], LOW);

		// Update the timer
		this->timer = us;
	}
}

void LedMatrix::setPixel(int x, int y, bool state)
{
	int tmp;

	// Transform the pixel location based on current rotation mode
	switch( this->mode )
	{
		case LED_MATRIX_0DEG:
			// Already in the right place
			break;
		case LED_MATRIX_90DEG:
			// Swap x,y and flip x
			tmp = y;
			y = x;
			x = this->apin_count - 1 - tmp;
			break;
		case LED_MATRIX_180DEG:
			// Flip x,y
			y = this->apin_count - 1 - y;
			x = this->cpin_count - 1 - x;
			break;
		case LED_MATRIX_270DEG:
			// Swap x,y and flip y
			tmp = y;
			y = this->cpin_count - 1 - x;
			x = tmp;
			break;
	}

	// Check bounds of transformed pixel location
	if( x >= 0 && x <= this->cpin_count && y >= 0 && y <= this->apin_count )
	{
		this->state[y][x] = state;
	}
}

void LedMatrix::draw(bool *data, int x, int y, int width, int height)
{
	// Just iterate over array and call SetPixel
	for( int r = 0; r < width; r++ )
	{
		for( int c = 0; c < height; c++ )
		{
			this->setPixel(x + r, y + c, data[c * width + r]);
		}
	}
}

void LedMatrix::clear()
{
	// Set all of the memory of this->state to 0 (false)
	memset(this->state, 0, sizeof(this->state));
}

void LedMatrix::setMode(LedMatrixMode mode)
{
	this->mode = mode;
}

void LedMatrix::setDelay(unsigned long micros)
{
	this->delay = micros;
}

void LedMatrix::drawByte(byte data, int x, int y, bool horizontal)
{
	for( int a = 0; a < 8; a++ )
	{
		if( horizontal )
		{
			this->setPixel(x + a, y, data & (0x01 << (7 - a)));
		}
		else
		{
			this->setPixel(x, y + a, data & (0x01 << (7 - a)));
		}
	}
}

void LedMatrix::drawBytes(byte *data, int count, int x, int y, bool horizontal)
{
	for( int a = 0; a < count; a++ )
	{
		if( horizontal )
		{
			this->drawByte( data[a], x, y + a, horizontal );
		}
		else
		{
			this->drawByte( data[a], x + a, y, horizontal );
		}
	}
}

// Just a blob of data storing ascii characters
// Each byte represents a vertical line of the 8 bit high character, each character is 5 bits wide
byte ascii_5x8[][5] =
{
	{0x0,	0x0,	0x0,	0x0,	0x0},
	{0x0,	0x0,	0x0,	0x0,	0x0},
	{0x0,	0x0,	0x0,	0x0,	0x0},
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	{0x0,   0x0,    0x0,    0x0,    0x0},
};
